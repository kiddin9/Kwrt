// SPDX-License-Identifier: (GPL-2.0+ OR MIT)
/*
 * Copyright (c) 2021 Rockchip Electronics Co., Ltd.
 *
 */

/dts-v1/;

#include "rk3588s-orangepi-5.dts"

&sata0 {
	status = "okay";
};

&pcie2x1l2 {
	status = "disabled";
};

&wireless_wlan {
	status = "disabled";
};

&wireless_bluetooth {
	status = "disabled";
};
